## config/west.yml
```yaml
manifest:
  defaults:
    revision: v0.3
  remotes:
    - name: zmkfirmware
      url-base: https://github.com/zmkfirmware
    # Additional modules containing boards/shields/custom code can be listed here as well
    # See https://docs.zephyrproject.org/3.2.0/develop/west/manifest.html#projects
    - name: m165437
      url-base: https://github.com/M165437
  projects:
    - name: zmk
      remote: zmkfirmware
      import: app/west.yml
    - name: nice-view-gem
      remote: m165437
      revision: 7794ebf7f75d7e16cb05240bcffe6c5a45ef5b44 # last commit compatible with zmk v0.3's LVGL 8; main moved to LVGL 9/zephyr v4.1
  self:
    path: config
```
